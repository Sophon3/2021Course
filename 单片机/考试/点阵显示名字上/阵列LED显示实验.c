
/*
P0，P2接“点阵LED”的J16、J17（列）；P1，P3接“点阵LED”的J14、J15（行）
取模：阳码，逐行。C51
*/
#include<reg52.h>
#define uint unsigned int 
#define uchar unsigned char

/*uint code Tab[][96] = {
	{
		0xFF,0xFF,0xFF,0xFF,0xFF,0xFF,0xFF,0xFF,0xFF,0xFF,0xFF,0xFF,0xFF,0xFF,0xFF,0xFF,
   0xFF,0xFF,0xFF,0xFF,0xFF,0xFF,0xFF,0xFF,0xFF,0xFF,0xFF,0xFF,0xFF,0xFF,0xFF,0xFF,
		0xBF,0xFF,0x7F,0xFF,0x01,0x80,0xED,0xBB,0x76,0xD7,0x0B,0xE8,0x7F,0xFF,0x01,0xC0,
   0xDF,0xDE,0xB7,0xEE,0x6F,0xFF,0x00,0x80,0xBF,0xF9,0xDF,0xF7,0xE7,0xEF,0xF9,0xDF,
	0xFF,0xFF,0xFF,0xFF,0xFF,0xFF,0xFF,0xFF,0xFF,0xFF,0xFF,0xFF,0xFF,0xFF,0xFF,0xFF,
   0xFF,0xFF,0xFF,0xFF,0xFF,0xFF,0xFF,0xFF,0xFF,0xFF,0xFF,0xFF,0xFF,0xFF,0xFF,0xFF},

	};*/
	uint code Tab[][128] = {
	{
		0xFF,0xFF,0xFF,0xFF,0xFF,0xFF,0xFF,0xFF,0xFF,0xFF,0xFF,0xFF,0xFF,0xFF,0xFF,0xFF,
  0xFF,0xFF,0xFF,0xFF,0xFF,0xFF,0xFF,0xFF,0xFF,0xFF,0xFF,0xFF,0xFF,0xFF,0xFF,0xFF,
	0x7F,0xFF,0xFF,0xFE,0x03,0x80,0xFB,0xFE,0x0B,0xE0,0xFB,0xEE,0x03,0x80,0xFB,0xEE,
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	0x7B,0xEF,0x7C,0x9F,0x7F,0xFF,0xFF,0xFF,0xDB,0xEE,0xBB,0xDD,0xBD,0xDD,0xFE,0xDF,/*"杰",2*/

	}
};//

void mDelay(uint Delay)	//延时
{	uchar i;
	for(;Delay > 0;Delay--)
		for(i = 0;i < 110;i++);
}

void main()				//主函数
{
	uchar i,j,a,b;
	uint k;
	while(1)
	{ 
		for(i = 64;i>0;i--)			 	//
		{
			for(k = 0;k < 10;k++)		   	//每一个字扫描显示100次
			{
				P1 = 0;					  	//设置初始值
				P3 = 0;
				a = 1;
				b = 1;
				for(j = 0;j < 16;j++)	   	//扫描16行点阵
				{
					P0 = Tab[0][(j+i)*2];		//扫描每一行的前八位    循环时对数组进行处理 （j+i）*/，会发生数组越界，+至64即可
					P2 = Tab[0][(j+i)*2+1];		//扫描每一行的后八位   
					
					if(j < 8)				//前八行设置哪一行显示
					{
						P1 = P1|a;			//当前显示的那一行置高
						mDelay(1);
						P1 = P1&0;
						a *= 2;
					}
					else					//后八行设置哪一行显示
					{
						P3 = P1|b;			//当前显示的那一行置高
						mDelay(1);
						P3 = P3&0;
						b *= 2;	
					}
				}				
			}
		}
    }
}
