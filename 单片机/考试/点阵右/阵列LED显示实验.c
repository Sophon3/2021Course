
/*
P0，P2接“点阵LED”的J16、J17（列）；P1，P3接“点阵LED”的J14、J15（行）
取模：阳码，逐行。C51
*/
#include<reg52.h>
#define uint unsigned int 
#define uchar unsigned char

/*uint code Tab[][96] = {
	{
		0xFF,0xFF,0xFF,0xFF,0xFF,0xFF,0xFF,0xFF,0xFF,0xFF,0xFF,0xFF,0xFF,0xFF,0xFF,0xFF,
   0xFF,0xFF,0xFF,0xFF,0xFF,0xFF,0xFF,0xFF,0xFF,0xFF,0xFF,0xFF,0xFF,0xFF,0xFF,0xFF,
		0xBF,0xFF,0x7F,0xFF,0x01,0x80,0xED,0xBB,0x76,0xD7,0x0B,0xE8,0x7F,0xFF,0x01,0xC0,
   0xDF,0xDE,0xB7,0xEE,0x6F,0xFF,0x00,0x80,0xBF,0xF9,0xDF,0xF7,0xE7,0xEF,0xF9,0xDF,
	0xFF,0xFF,0xFF,0xFF,0xFF,0xFF,0xFF,0xFF,0xFF,0xFF,0xFF,0xFF,0xFF,0xFF,0xFF,0xFF,
   0xFF,0xFF,0xFF,0xFF,0xFF,0xFF,0xFF,0xFF,0xFF,0xFF,0xFF,0xFF,0xFF,0xFF,0xFF,0xFF},

	};*/
	uint code Tab[][128] = {
	{
		
0x00,0x40,0x00,0x30,0xFC,0x0F,0x44,0x00,0x54,0xFD,0x54,0x45,0x54,0x45,0x55,0x45,
0xFE,0x47,0x54,0x45,0x54,0x45,0x54,0x45,0xF4,0xFD,0x44,0x00,0x44,0x00,0x00,0x00,/*"唐",0*/

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0x00,0x00,0x00,0x00,0x00,0x00,0x00,0x00,0x00,0x00,0x00,0x00,0x00,0x00,0x00,0x00,
	}
};//

void mDelay(uint Delay)	//延时
{	uchar i;
	for(;Delay > 0;Delay--)
		for(i = 0;i < 110;i++);
}

void main()				//主函数
{
	unsigned char j,i,n;
	unsigned int k;
	while(1)
	{ 
		for(i=64;i>0;i--){
			for(k = 0;k < 10;k++)		   	//每一个字扫描显示100次
			{
				P0 = 0xff;					  	//设置初始值
				P2 = 0xff;
				for(j = 0;j < 16;j++)	   	//扫描16行点阵
				{
					P1 = Tab[0][(j+i)*2];		//扫描每一行的前八位
					P3 = Tab[0][(j+i)*2+1];		//扫描每一行的后八位
					
					if(j < 8)				//前八行设置哪一行显示
					{
						P0 = ~(0x01<<j);			//当前显示的那一行置高
						mDelay(1);
						P0 = 0xff;
					}
					else					//后八行设置哪一行显示
					{
						n=j%8;
						P2 = ~(0x01<<n);			//当前显示的那一行置高
						mDelay(1);
						P2 = 0xff;
					}
				}				
			}
		}
	}
}
